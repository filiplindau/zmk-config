/* Disable I2C (TWI0) so SPI0 can be used for the nice!view */
&i2c0 {
    status = "disabled";
};

&pro_micro_i2c {
    status = "disabled";
};

/* 2. Delete the default OLED nodes using the correct top-level syntax */
/delete-node/ &left_oled;
/delete-node/ &right_oled;

/* 3. Configure the nice!view SPI and CS pin */
&nice_view_spi {
    status = "okay";
    cs-gpios = <&pro_micro 4 GPIO_ACTIVE_HIGH>;
};